#include <ESP8266WiFi.h>
#include <DNSServer.h>
#include <ESP8266WebServer.h>
#include <WiFiManager.h>
#include <Wire.h>
#include <Adafruit_Sensor.h>
#include <Adafruit_BME280.h>
#include <Wire.h>
#include <Adafruit_GFX.h>
#include <Adafruit_SSD1306.h>
#include "fuzzy.h"
#include "IoT.h"

#define SCREEN_WIDTH 128 // OLED display width, in pixels
#define SCREEN_HEIGHT 64 // OLED display height, in pixels
#define OLED_RESET -1    // Reset pin # (or -1 if sharing Arduino reset pin)
Adafruit_SSD1306 oled(SCREEN_WIDTH, SCREEN_HEIGHT, &Wire, OLED_RESET);

#define SEALEVELPRESSURE_HPA (1013.25)

#define RelayA D7
#define RelayB D8

Adafruit_BME280 bme;
float in_suhu = 0;
float in_humi = 0;
int timeon = 0;

const unsigned char logo[] PROGMEM = {
    0x00, 0x00, 0x00, 0x00, 0x00, 0x00, 0x00, 0x00, 0x00, 0x00, 0x00, 0x00, 0x00, 0x00, 0x00, 0x00,
    0x00, 0x00, 0x00, 0x00, 0x00, 0x00, 0x00, 0x00, 0x00, 0x00, 0x00, 0x00, 0x00, 0x00, 0x00, 0x00,
    0x00, 0x00, 0x00, 0x00, 0x00, 0x00, 0x00, 0x00, 0x00, 0x00, 0x00, 0x00, 0x00, 0x00, 0x00, 0x00,
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    0x00, 0x00, 0x00, 0x00, 0x00, 0x00, 0x00, 0x00, 0x00, 0x00, 0x00, 0x00, 0x00, 0x00, 0x00, 0x00};

const unsigned char logo_humi[] PROGMEM = {
    0x00, 0x00, 0x00, 0x00, 0x00, 0x00, 0x00, 0x00, 0x00, 0x00, 0x00, 0x00, 0x00, 0x3f, 0xc0, 0x00,
    0x00, 0xff, 0xf0, 0x00, 0x01, 0xc0, 0x38, 0x00, 0x03, 0x80, 0x1c, 0x00, 0x06, 0x0f, 0xc6, 0x00,
    0x0e, 0xc1, 0xe7, 0x00, 0x0c, 0xe0, 0x73, 0x00, 0x09, 0xf0, 0x39, 0x80, 0x19, 0xb8, 0x19, 0x80,
    0x19, 0x9e, 0x19, 0x80, 0x19, 0x0f, 0x09, 0x80, 0x18, 0x0f, 0x00, 0x00, 0x18, 0x06, 0x00, 0x00,
    0x18, 0x00, 0x03, 0x00, 0x08, 0x00, 0x07, 0x80, 0x0c, 0x00, 0x07, 0xc0, 0x0e, 0x00, 0x0f, 0xc0,
    0x06, 0x00, 0x0f, 0xe0, 0x03, 0x80, 0x1f, 0xe0, 0x01, 0xc0, 0x1f, 0xf0, 0x00, 0xff, 0x9f, 0xf0,
    0x00, 0x3f, 0x9f, 0xf0, 0x00, 0x00, 0x1f, 0xe0, 0x00, 0x00, 0x0f, 0xe0, 0x00, 0x00, 0x07, 0x80};

const unsigned char logo_temp[] PROGMEM = {
    0x00, 0x00, 0x00, 0x00, 0x00, 0x00, 0x00, 0x00, 0x00, 0x00, 0x00, 0x00, 0x00, 0x00, 0x00, 0x00,
    0x00, 0x0f, 0xfc, 0x00, 0x00, 0x0f, 0xfc, 0x00, 0x00, 0x0c, 0x30, 0x00, 0x00, 0x0c, 0x30, 0x00,
    0x00, 0x0d, 0xbc, 0x00, 0x00, 0x0d, 0xbc, 0x00, 0x00, 0x0d, 0xb0, 0x00, 0x00, 0x0d, 0xb0, 0x00,
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    0x00, 0x00, 0x00, 0x00, 0x00, 0x00, 0x00, 0x00, 0x00, 0x00, 0x00, 0x00, 0x00, 0x00, 0x00, 0x00};

const unsigned char check[] PROGMEM = {
    0xff, 0xff, 0xff, 0xff, 0xff, 0xff, 0xff, 0xff, 0xff, 0xff, 0xff, 0xff, 0xff, 0xff, 0xff, 0xff,
    0xff, 0xff, 0xff, 0xff, 0xff, 0xff, 0xff, 0xff, 0xff, 0xff, 0xff, 0xff, 0xff, 0xff, 0xff, 0xff,
    0xff, 0xff, 0xff, 0xff, 0xff, 0xff, 0xff, 0xff, 0xff, 0xff, 0xff, 0xff, 0xff, 0xff, 0xff, 0xff,
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    0xff, 0xff, 0xff, 0xff, 0xff, 0xff, 0xff, 0xff, 0xff, 0xff, 0xff, 0xff, 0xff, 0xff, 0xff, 0xff};

void setup()
{
  Serial.begin(115200);
  if (!oled.begin(SSD1306_SWITCHCAPVCC, 0x3C))
  { // Address 0x3C for 128x32
    Serial.println(F("SSD1306 allocation failed"));
    for (;;)
      ; // Don't proceed, loop forever
  }

  for (int x = 0; x <= 100; x++)
  {
    oled.clearDisplay();
    oled.setTextColor(WHITE);
    oled.setTextSize(2);
    oled.setCursor(50, 25);
    oled.print(x);
    oled.println("%");
    oled.display();
  }
  delay(1000);
  oled.clearDisplay();
  oled.setTextSize(2);
  oled.drawBitmap(0, 0, logo, 128, 64, WHITE);
  oled.display();
  delay(2000);

  oled.clearDisplay();
  oled.setTextColor(WHITE);
  oled.setTextSize(2);
  oled.setCursor(25, 0);
  oled.println("waiting");
  oled.setCursor(50, 25);
  oled.println("for");
  oled.setCursor(5, 45);
  oled.println("connection");
  oled.display();

  WiFi.mode(WIFI_STA);
  WiFiManager wifiManager;
  // wifiManager.resetSettings();
  //  String APnameString = "SmartGarden-"+ String(ESP.getChipId(),HEX);
  //  char* APname;
  //  APnameString.toCharArray(APname,50);
  wifiManager.autoConnect("SmartGarden", "82668266");

  oled.clearDisplay();
  oled.setTextColor(WHITE);
  oled.setTextSize(2);
  oled.drawBitmap(0, 0, check, 128, 64, WHITE);
  oled.display();

  Serial.println("connected...yeey :)");
  delay(1000);

  pinMode(RelayA, OUTPUT);
  pinMode(RelayB, OUTPUT);
  digitalWrite(RelayA, LOW);
  digitalWrite(RelayB, LOW);
  bme.begin(0x76);
}

void loop()
{
  Serial.println("pembacaan data sensor");
  in_suhu = bme.readTemperature();
  in_humi = bme.readHumidity();

  oled.clearDisplay();
  oled.setTextColor(WHITE);
  oled.setTextSize(2);
  oled.drawBitmap(10, 0, logo_temp, 32, 32, WHITE);
  oled.setCursor(33, 10);
  oled.print(" = ");
  int suhuOled = in_suhu;
  oled.print(suhuOled);
  oled.print((char)247);
  oled.println("C");
  oled.drawBitmap(10, 32, logo_humi, 28, 28, WHITE);
  oled.setCursor(33, 40);
  oled.print(" = ");
  int humiOled = in_humi;
  oled.print(humiOled);
  oled.println("%");
  oled.display();

  fuzzy(in_suhu, in_humi);
  int timecentroid = millis(); //waktu awal mulai

  while ((Centroid * 1000) >= ((millis() - timecentroid)))
  { ///sambil nunggu centroid, update LCD
    digitalWrite(RelayA, HIGH);
    digitalWrite(RelayB, HIGH);
    in_suhu = bme.readTemperature();
    in_humi = bme.readHumidity();
    oled.clearDisplay();
    oled.setTextColor(WHITE);
    oled.setTextSize(2);
    oled.drawBitmap(10, 0, logo_temp, 32, 32, WHITE);
    oled.setCursor(33, 10);
    oled.print(" = ");
    int suhuOled = in_suhu;
    oled.print(suhuOled);
    oled.print((char)247);
    oled.println("C");
    oled.drawBitmap(10, 32, logo_humi, 28, 28, WHITE);
    oled.setCursor(33, 40);
    oled.print(" = ");
    int humiOled = in_humi;
    oled.print(humiOled);
    oled.println("%");
    oled.display();
  }

  digitalWrite(RelayA, LOW);
  digitalWrite(RelayB, LOW);
  timeon = millis();
  if (timeon == 0 || ((millis() - timeon) / 1000) >= (60 * 5))
  {
    timeon = millis();
    sendData(in_humi, in_suhu);
  }
}
