#include <Wire.h>
#include <Adafruit_GFX.h>
#include <Adafruit_SSD1306.h>
#include "Fuzzy.h"

#define SCREEN_WIDTH 128 // OLED display width, in pixels
#define SCREEN_HEIGHT 32 // OLED display height, in pixels
#define sensor_pin A0

float moisture[100];
float sensor;
float avg_moisture;

#define OLED_RESET     -1 // Reset pin # (or -1 if sharing Arduino reset pin)
Adafruit_SSD1306 oled(SCREEN_WIDTH, SCREEN_HEIGHT, &Wire, OLED_RESET);

String status_biji = "";

// 'Screenshot 2021-09-13 145820', 128x32px
const unsigned char SMOTER[] PROGMEM = {
  0x00, 0x00, 0x00, 0x00, 0x00, 0x00, 0x00, 0x00, 0x00, 0x00, 0x00, 0x00, 0x00, 0x00, 0x00, 0x00,
  0x00, 0x00, 0x00, 0x00, 0x00, 0x00, 0x00, 0x00, 0x00, 0x00, 0x00, 0x00, 0x00, 0x00, 0x00, 0x00,
  0x00, 0x00, 0x00, 0x00, 0x00, 0x00, 0x00, 0x00, 0x00, 0x00, 0x00, 0x00, 0x00, 0x00, 0x00, 0x00,
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  0x00, 0x00, 0x00, 0x00, 0x00, 0x00, 0x00, 0x00, 0x00, 0x00, 0x00, 0x00, 0x00, 0x00, 0x00, 0x00
};

const unsigned char logo_air [] PROGMEM = {
  0x00, 0x00, 0x00, 0x00, 0x00, 0x00, 0x00, 0x00, 0x00, 0x00, 0x00, 0x00, 0x00, 0x18, 0x00, 0x00,
  0x00, 0x3c, 0x01, 0xf8, 0x00, 0x3c, 0x01, 0xf8, 0x00, 0x7e, 0x01, 0xf8, 0x00, 0xff, 0x00, 0x18,
  0x01, 0xe7, 0x80, 0x18, 0x01, 0xc3, 0x80, 0xf8, 0x03, 0x81, 0xc0, 0xf8, 0x07, 0x81, 0xe0, 0xf8,
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  0x00, 0xff, 0x00, 0x00, 0x00, 0x00, 0x00, 0x00, 0x00, 0x00, 0x00, 0x00, 0x00, 0x00, 0x00, 0x00
};

float error, D_error;
float set_point = 15;

void setup() {
  Serial.begin(9600);
  if (!oled.begin(SSD1306_SWITCHCAPVCC, 0x3C)) { // Address 0x3C for 128x32
    Serial.println(F("SSD1306 allocation failed"));
    for (;;); // Don't proceed, loop forever
  }

  for (int x = 0; x <= 100; x++) {
    oled.clearDisplay();
    oled.setTextColor(WHITE);
    oled.setTextSize(2);
    oled.setCursor(50, 10);
    oled.print(x);
    oled.println("%");
    oled.display();
  }
  delay(1000);

  oled.clearDisplay();
  oled.setTextSize(2);
  oled.drawBitmap(0, 0, SMOTER, 128, 32, WHITE);
  oled.display();
  delay(2000);
}

void loop() {

  for (int x = 0; x <= 100; x++) {
    
    sensor = analogRead(sensor_pin);
    
    oled.clearDisplay();
    oled.setTextColor(WHITE);
    oled.setTextSize(2);
    oled.drawBitmap(0, 0, logo_air, 32, 32, WHITE);
    oled.setCursor(25, 10);
    oled.println(" = ");
    oled.setCursor(55, 10);
    oled.println("Scan");
    oled.display();
    
    moisture[x] = map(sensor, 800, 200, 0, 100);
    if (moisture[x] < 0) {
      moisture [x] = 0;
    }
    Serial.print("Sensor ");
    Serial.print(x);
    Serial.print(" :");
    Serial.println(moisture[x]);
    avg_moisture += moisture[x];
  }

  //Display Fuzzy
  float error_1 = error;
  error   = (avg_moisture / 100) - set_point;
  D_error = error - error_1;

  Serial.print("\n\nError : ");
  Serial.println(error);
  Serial.print("D_error : ");
  Serial.println(D_error);

  fuzzy(error, D_error);
  Serial.print("AVG Mois : ");
  Serial.println((avg_moisture / 1000));
  Serial.print("\n\n");

  float mois_oled = avg_moisture / 1000;
  oled.clearDisplay();
  oled.setTextColor(WHITE);
  oled.setTextSize(2);
  oled.drawBitmap(0, 0, logo_air, 32, 32, WHITE);
  oled.setCursor(25, 10);
  oled.println(" = ");
  oled.setCursor(55, 10);
  oled.println(mois_oled);
  oled.display();
  delay(5000);

  //Display Kondisi
  oled.clearDisplay();
  oled.setTextColor(WHITE);
  oled.setTextSize(2);
  oled.drawBitmap(0, 0, logo_air, 32, 32, WHITE);
  oled.setCursor(25, 10);
  oled.println(" = ");

  if (centroid < 2) {
    status_biji = "Baik";
  }
  else if (centroid >= 2 && centroid < 3) {
    status_biji = "Cukup";
  }
  else {
    status_biji = "Kurang";
  }

  oled.setCursor(55, 10);
  oled.println(status_biji);
  oled.display();
  avg_moisture = 0;
  delay(5000);
}
